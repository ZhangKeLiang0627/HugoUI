#include "HugoUI_User.h"
#include "Hugo_UI.h"
#include "OLED_User.h"
#include "malloc.h"
#include "oled.h"
#include "BEEPER.h"

#include "mpu6050.h"
#include "inv_mpu.h"
#include "inv_mpu_dmp_motion_driver.h" 

#include "SHT30.h"

#include "usart.h"

#include "Key.h"
/******************************图片存放区******************************/
const uint8_t Setting_BMP[] = {
0x00,0x00,0x00,0x00,0x00,0x00,0x00,0x00,0xE0,0x0F,0x00,0x00,0xE0,0x0F,0x00,0x00,
0x7C,0xFC,0xFF,0x3F,0x7C,0xFC,0xFF,0x3F,0x7C,0xFC,0xFF,0x3F,0xE0,0x0F,0x00,0x00,
0xE0,0x0F,0x00,0x00,0x00,0x00,0x00,0x00,0x00,0x00,0x00,0x00,0x00,0x00,0x00,0x00,
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0x00,0xF0,0x07,0x00,0x00,0xF0,0x07,0x00,0x00,0x00,0x00,0x00,0x00,0x00,0x00,0x00,
/* 32*32 */
};

const uint8_t Poet_BMP[] = {
0x00,0x00,0x00,0x00,0x00,0x00,0x00,0x00,0x00,0x00,0x00,0x00,0x00,0x00,0x00,0x00,
0x00,0x00,0x00,0x00,0x00,0x00,0x7E,0x00,0x00,0x00,0x7E,0x00,0x00,0x80,0xE7,0x01,
0x00,0x80,0xE7,0x01,0x00,0xE0,0x81,0x07,0x00,0xE0,0x81,0x07,0x00,0x78,0x18,0x06,
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0x18,0x00,0x00,0x00,0x00,0x00,0x00,0x00,0x00,0x00,0x00,0x00,0x00,0x00,0x00,0x00,
/* 32*32 */
};

const u8 Robot_BMP[]= {
0x00,0x00,0x00,0x00,0x00,0x00,0x00,0x00,0x00,0x00,0x00,0x00,0x00,0x00,0x00,0x00,
0x00,0xE0,0x03,0x00,0x00,0xE0,0x03,0x00,0x00,0xE0,0x03,0x00,0x00,0xE0,0x03,0x00,
0x00,0xE0,0x03,0x00,0x00,0xE0,0x03,0x00,0x80,0xFF,0xFF,0x00,0x80,0xFF,0xFF,0x00,
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0x00,0x00,0x00,0x00,0x00,0x00,0x00,0x00,0x00,0x00,0x00,0x00,0x00,0x00,0x00,0x00,
/* 32*32 */

};

const u8 Knife_BMP[] = {
0x00,0x00,0x00,0x00,0x00,0x00,0x00,0x00,0x00,0x00,0x00,0x00,0x00,0x60,0xE0,0x07,
0x00,0x60,0xE0,0x07,0x00,0x60,0x18,0x18,0x00,0x60,0x18,0x18,0x80,0x61,0x06,0x18,
0x80,0x61,0x06,0x18,0x00,0x86,0x01,0x18,0x00,0x86,0x01,0x18,0x00,0x00,0x00,0x06,
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0xE0,0x07,0x06,0x00,0x00,0x00,0x00,0x00,0x00,0x00,0x00,0x00,0x00,0x00,0x00,0x00,
/* 32*32 */
};

const u8 Lighting_BMP[] = {
0x00,0x00,0x00,0x00,0x00,0x00,0x00,0x00,0x00,0x00,0x00,0x00,0x00,0x00,0x30,0x00,
0x00,0x00,0x30,0x00,0x00,0x00,0x3C,0x00,0x00,0x00,0x3C,0x00,0x00,0x00,0x0B,0x00,
0x00,0x00,0x0B,0x00,0x00,0xC0,0x08,0x00,0x00,0xC0,0x08,0x00,0x00,0x30,0x08,0x00,
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0x00,0x06,0x00,0x00,0x00,0x00,0x00,0x00,0x00,0x00,0x00,0x00,0x00,0x00,0x00,0x00,
/* 32*32 */
};

/******************************图片存放区******************************/

/******************************变量存放区******************************/

// 开关控件变量
uint8_t SmoothAnimation_Flag = true; // 缓动动画标志位 // 缓动动画flag需要在HugoUI_Control中使用，建议不要改动！（don't change this one!!!）
uint8_t OptionStripFixedLength_Flag = false;

uint8_t CheckBox1_flag = true;
uint8_t CheckBox2_flag = false;
uint8_t CheckBox3_flag = false;

uint8_t Switch1_flag = true;
uint8_t Switch2_flag = false;
uint8_t Switch3_flag = false;
uint8_t BeeperEnable_flag = true;
uint8_t PageListMode_flag = false;
extern uint8_t ListMode1;
extern uint8_t ListMode2;


// 滑动条变量
paramType val1 = 0.11f;
paramType val2 = 0.22f;
paramType val3 = 0.33f;
paramType BeeperLoud = 0;

paramType ScreenBrightness = 255;
paramType MenuScroll = 0;

float pitch,roll,yaw; 		
short aacx,aacy,aacz;		
short gyrox,gyroy,gyroz;

/******************************变量存放区******************************/



/******************************结构体存放区******************************/


//由于sizeof的原理是在编译阶段由编译器替换数组大小，因此我们无法计算指针的sizeof！需要在位图的第一个字节填写 n 阶矩阵图像

uint8_t* Switch_space[] = {
    &SmoothAnimation_Flag, // 缓动动画flag需要在HugoUI_Control中使用，建议不要改动！（don't change this one!!!）
    &OptionStripFixedLength_Flag,
    &CheckBox1_flag,
    &CheckBox2_flag,
    &CheckBox3_flag,
    &Switch1_flag,
    &Switch2_flag,
    &Switch3_flag,
    &BeeperEnable_flag,
    &PageListMode_flag,
    &ListMode1,
    &ListMode2,
    
};


/**
*    @结构体 Slide_Bar Slide_space[]
*    @brief 滑动条控件 用于存储滑动条控件的值(即储存param)
*    @param none
*
*    @变量
*        int   val    值
*        int   min  最小值
*        int   max  最大值
*        int   step 步进
*/

struct Slide_Bar Slide_space[] = {
    {(float*) &ScreenBrightness,      0,   255,     16},        //亮度调整
    {(float*) &MenuScroll,            0, SCREEN_HEIGHT/16, 1},  //自适应菜单滚动范围
    
    {(float*) &val1,                  0,   10,    0.1},        //param
    {(float*) &val2,                  0,   10,    0.5},
    {(float*) &val3,                  0,   10,    0.01},
    {(float*) &BeeperLoud,            0,    98,      5},

};


/******************************结构体存放区******************************/


void HugoUI_InitLayout(void)
{
    /* 注册Page */
    HugoUIPage_t *pageMain = AddPage(PAGE_CUSTOM, "pageMain");
    HugoUIPage_t *pageSetting = AddPage(PAGE_LIST, "pageSetting");
    HugoUIPage_t *pagePID = AddPage(PAGE_LIST, "pagePID");
    HugoUIPage_t *pageCheckBox = AddPage(PAGE_LIST, "pageCheckBox");


    /* 注册 Item */ 
    // PageMain
    pageMain->AddItem(pageMain, "Setting", ITEM_JUMP_PAGE)
            ->SetJumpId(pageSetting->pageId, 0)
            ->SetIconSrc(Setting_BMP);

    pageMain->AddItem(pageMain, "CheckBox", ITEM_JUMP_PAGE)
            ->SetJumpId(pageCheckBox->pageId, 0)
            ->SetIconSrc(Lighting_BMP);
    
    pageMain->AddItem(pageMain, "DVA!", ITEM_CHECKBOX, &CheckBox1_flag, NULL)
            ->SetIconSrc(Robot_BMP);

    pageMain->AddItem(pageMain, "Poet", ITEM_CALL_FUNCTION, EventShowGyroUI)
            ->SetIconSrc(Poet_BMP);

    pageMain->AddItem(pageMain, "checkbox3", ITEM_CHECKBOX, &CheckBox3_flag, NULL)
            ->SetIconSrc(Knife_BMP);

    pageMain->AddItem(pageMain, "frameBox2", ITEM_PAGE_DESCRIPTION)
            ->SetIconSrc(Knife_BMP);

    pageMain->AddItem(pageMain, "Hugo!", ITEM_PAGE_DESCRIPTION)
            ->SetIconSrc(Poet_BMP);
    pageMain->AddItem(pageMain, "Hugo!!!!", ITEM_PAGE_DESCRIPTION)
            ->SetIconSrc(Lighting_BMP);

    // PageSetting
    pageSetting->AddItem(pageSetting, "Setting", ITEM_PAGE_DESCRIPTION);
    pageSetting->AddItem(pageSetting, "PID Editor", ITEM_JUMP_PAGE)
               ->SetJumpId(pagePID->pageId, 0);
    
    pageSetting->AddItem(pageSetting, "SmoothAnim", ITEM_SWITCH, &SmoothAnimation_Flag, NULL);
    pageSetting->AddItem(pageSetting, "LightLevel", ITEM_CHANGE_VALUE, &ScreenBrightness, Oled_EventUpdateOledLightLevel);
    pageSetting->AddItem(pageSetting, "BeepEnable", ITEM_SWITCH, &BeeperEnable_flag, EventBeeperEnableConfig);
    pageSetting->AddItem(pageSetting, "Page2List", ITEM_SWITCH, &PageListMode_flag, NULL);
    pageSetting->AddItem(pageSetting, "Volume Ctrl", ITEM_CHANGE_VALUE, &BeeperLoud, EventBeeperVolumeControl);
    pageSetting->AddItem(pageSetting, "ListMode1", ITEM_CHECKBOX, &ListMode1, EventChangeListMode1);
    pageSetting->AddItem(pageSetting, "ListMode2", ITEM_CHECKBOX, &ListMode2, EventChangeListMode2);
    pageSetting->AddItem(pageSetting, "Set6", ITEM_PAGE_DESCRIPTION);

    
    pageSetting->AddItem(pageSetting, "Exit", ITEM_JUMP_PAGE)
               ->SetJumpId(pageMain->pageId, 0);

    // PageCheckBox
    pageCheckBox->AddItem(pageCheckBox, "CheckBox", ITEM_PAGE_DESCRIPTION);
    pageCheckBox->AddItem(pageCheckBox, "cbox1", ITEM_PAGE_DESCRIPTION);
    pageCheckBox->AddItem(pageCheckBox, "cbox2", ITEM_PAGE_DESCRIPTION);
    pageCheckBox->AddItem(pageCheckBox, "cbox3", ITEM_PAGE_DESCRIPTION);
    pageCheckBox->AddItem(pageCheckBox, "Exit", ITEM_JUMP_PAGE)
                ->SetJumpId(pageMain->pageId, 1);


    // PagePID
    pagePID->AddItem(pagePID, "PID Editor", ITEM_PAGE_DESCRIPTION);
    pagePID->AddItem(pagePID, "PID_Kp", ITEM_CHANGE_VALUE, &val1, NULL);
    pagePID->AddItem(pagePID, "PID_Ki", ITEM_CHANGE_VALUE, &val2, NULL);
    pagePID->AddItem(pagePID, "PID_Kd", ITEM_CHANGE_VALUE, &val3, NULL);
    pagePID->AddItem(pagePID, "Exit", ITEM_JUMP_PAGE)
           ->SetJumpId(pageSetting->pageId, 1);


    // ItemTail = ItemHead;
    // while(ItemTail != NULL)
    // {
    //     printf("name:%s\r\n", ItemTail->title);
    //     printf("lid:%d\r\n", ItemTail->lineId);
    //     printf("id:%d\r\n", ItemTail->itemId);
    //     ItemTail = ItemTail->next;
    // }
    // pageTail = pageHead;
    // while(pageTail != NULL)
    // {
    //     printf("name:%s\r\n", pageTail->title);
    //     printf("id:%d\r\n", pageTail->pageId);
    //     pageTail = pageTail->next;
    // }

    printf("内存占用情况：%d\r\n", my_mem_perused(SRAMIN));
    printf("itemMax:%d\r\n",pageMain->itemMax);
}

/* Little Event */
/* 对于SSD1306型号的Oled的调节屏幕亮度的函数 */
void EventUpdateOledLightLevel(void)
{
    WriteCmd(0x81); /*contrast control*/ 
	WriteCmd((uint8_t)*Slide_space[Slide_space_ScreenBrightness].val); /*255*/ 
}

/* 蜂鸣器使能事件函数 */
void EventBeeperEnableConfig(void)
{
    Beeper0.Beeper_Enable = BeeperEnable_flag;
}

/* 蜂鸣器音量控制事件函数 */
void EventBeeperVolumeControl(void)
{
    Beeper0.Sound_Loud = (uint8_t)BeeperLoud;
}

/* 改变list滚动模式事件函数1 */
void EventChangeListMode1(void)
{
    if(!ListMode1) ListMode2 = true;
    else ListMode2 = false;
}

/* 改变list滚动模式事件函数2 */
void EventChangeListMode2(void)
{
    if(!ListMode2) ListMode1 = true;
    else ListMode1 = false;
}

/* Large Event */

extern uint8_t mpu6050_set_flag;
extern uint8_t sht30_set_flag;

float Temperature, Humidity;

void EventShowGyroUI(void)
{
    static uint8_t res1 = 1, res2 = 1;

    Oled_u8g2_ShowStr(0,13,"IMU:");
    if(!res1 && !res2) Oled_u8g2_ShowStr(100,13,"OK");
    else Oled_u8g2_ShowStr(100,13,"ERR"); 

    if(res1 == 1)
    {
        res1 = MPU_Init();
	    printf("MPU_Init = %d\r\n", res1);
        HugoUISendBuffer();
    }
	if(res2 == 1)
    {
        res2 = mpu_dmp_init();
	    printf("mpu_dmp_Init = %d\r\n", res2);
    }

    if(sht30_set_flag)
    {
	    sht30_set_flag = 0;
    	SHT30_Read_ValueOut(0x44, &Temperature, &Humidity);
        
    }
    if(mpu6050_set_flag && !res1 && !res2)
    {
        mpu6050_set_flag = 0;
    	mpu_dmp_get_data(&pitch,&roll,&yaw);
    	printf("pitch = %.1f ", pitch);
    	printf("roll = %.1f ", roll);
    	printf("yaw = %.1f\r\n", yaw);
    }
    
    Oled_u8g2_ShowFloat(50,13,Temperature,2,2);
    Oled_u8g2_ShowFloat(50,26,Humidity,2,2);

    
    Oled_u8g2_ShowFloat(0,26,pitch,2,2);

}





